#include "main.h"
#include "Analog_Clock.h"
#include "digital.h"

struct Stepper_Clock F_Stepper_Clock;
struct Stepper_Clock R_Stepper_Clock;

const unsigned char full_step_faz[8] = {
	0b00000001,
	0b00000010,
	0b00000100,
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	0b00001000,
};
/********************************************************************************************************************************************************************************************************/
/********************************************************************************************************************************************************************************************************/
/********************************************************************************************************************************************************************************************************/
void Stepper_Init(struct Stepper_Clock *Stp_Drv,
uint8_t Clk_Port,  uint8_t Clk_Pin,
uint8_t Data_Port,  uint8_t Data_Pin,
uint8_t Ref_12_Port,  uint8_t Ref_12_Pin,
uint8_t Ref_DK_Port, uint8_t Ref_DK_Pin)  // Ok.
{
	Stp_Drv->Clk_Port    = Clk_Port;
	Stp_Drv->Clk_Pin     = Clk_Pin;
	Stp_Drv->Data_Port   = Data_Port;
	Stp_Drv->Data_Pin    = Data_Pin;

	Stp_Drv->Ref_12_Port = Ref_12_Port;
	Stp_Drv->Ref_12_Pin  = Ref_12_Pin;
	Stp_Drv->Ref_DK_Port = Ref_DK_Port;
	Stp_Drv->Ref_DK_Pin  = Ref_DK_Pin;

	pinMode(D,Stp_Drv->Clk_Pin,  OUTPUT);
	pinMode(D,Stp_Drv->Data_Pin, OUTPUT);

	pinMode(C,Stp_Drv->Ref_12_Pin, INPUT); internalPullup(C, Stp_Drv->Ref_12_Pin, ENABLE);
	pinMode(C,Stp_Drv->Ref_DK_Pin, INPUT); internalPullup(C, Stp_Drv->Ref_DK_Pin, ENABLE);

	digitalWrite(D,Stp_Drv->Clk_Pin,  HIGH);
	digitalWrite(D,Stp_Drv->Data_Pin, HIGH);
	
	Stp_Drv->Dir   = CW;
	Stp_Drv->Phase = 1;
	Stp_Drv->Act=PASSIVE;
	Stp_Drv->Phase = 1;
	Stp_Drv->State = CLOCK_RESET;
	
	Stepper_Off(Stp_Drv);
	Stepper_Off(Stp_Drv);
}
/********************************************************************************************************************************************************************************************************/
/********************************************************************************************************************************************************************************************************/
/********************************************************************************************************************************************************************************************************/
static void send_mechanics_step(struct Stepper_Clock *Stp_Drv, unsigned char phase) // Ok.
{
	digitalWrite(D, Stp_Drv->Data_Pin, phase&0x08);	//ORANGE DATA.
	digitalWrite(D, Stp_Drv->Clk_Pin,  HIGH);
	digitalWrite(D, Stp_Drv->Clk_Pin,  LOW);

	digitalWrite(D, Stp_Drv->Data_Pin, phase&0x04); //YELLOW DATA.
	digitalWrite(D, Stp_Drv->Clk_Pin,  HIGH);
	digitalWrite(D, Stp_Drv->Clk_Pin,  LOW);

	digitalWrite(D, Stp_Drv->Data_Pin, phase&0x02); //PIMK DATA.
	digitalWrite(D, Stp_Drv->Clk_Pin,  HIGH);
	digitalWrite(D, Stp_Drv->Clk_Pin,  LOW);

	digitalWrite(D, Stp_Drv->Data_Pin, phase&0x01); //BLUE DATA.
	digitalWrite(D, Stp_Drv->Clk_Pin,  HIGH);
	digitalWrite(D, Stp_Drv->Clk_Pin,  LOW);
}
/********************************************************************************************************************************************************************************************************/
/********************************************************************************************************************************************************************************************************/
/********************************************************************************************************************************************************************************************************/
void Stepper_Off(struct Stepper_Clock *Stp_Drv) // Ok.
{
	send_mechanics_step(Stp_Drv, 0x00);
	Stp_Drv->Acceleration_Time = STEP_TIME_MAX;
}
/********************************************************************************************************************************************************************************************************/
/********************************************************************************************************************************************************************************************************/
/********************************************************************************************************************************************************************************************************/
void Stepper_Set_Reel_Pos_dk(struct Stepper_Clock *Stp_Drv, uint16_t m_reel_dk) // Ok.
{
	Stp_Drv->Reel_Pos_dk = m_reel_dk;
}
/********************************************************************************************************************************************************************************************************/
/********************************************************************************************************************************************************************************************************/
/********************************************************************************************************************************************************************************************************/
uint16_t Stepper_Get_Reel_Pos_dk(struct Stepper_Clock *Stp_Drv) // Ok.
{
	return Stp_Drv->Reel_Pos_dk;
}
/********************************************************************************************************************************************************************************************************/
/********************************************************************************************************************************************************************************************************/
/********************************************************************************************************************************************************************************************************/
uint16_t Stepper_Get_Scale_Pos_dk(struct Stepper_Clock *Stp_Drv)
{
	return Stp_Drv->Scale_Pos_dk;
}
/********************************************************************************************************************************************************************************************************/
/********************************************************************************************************************************************************************************************************/
/********************************************************************************************************************************************************************************************************/
uint16_t Stepper_Get_Reel_Pos_stp(struct Stepper_Clock *Stp_Drv)
{
	return Stp_Drv->Reel_Pos_stp;
}
/********************************************************************************************************************************************************************************************************/
/********************************************************************************************************************************************************************************************************/
/********************************************************************************************************************************************************************************************************/
uint16_t Stepper_Get_Scale_Pos_stp(struct Stepper_Clock *Stp_Drv)
{
	return Stp_Drv->Scale_Pos_stp;
}
/********************************************************************************************************************************************************************************************************/
/********************************************************************************************************************************************************************************************************/
/********************************************************************************************************************************************************************************************************/
void Stepper_Next_Step(struct Stepper_Clock *Stp_Drv) // Ok.
{
	if(Stp_Drv->Dir == CW)
	{
		Stp_Drv->Phase++;
		if(Stp_Drv->Phase>=8)
		{
			Stp_Drv->Phase = 0;
		}
	}
	else
	{
		Stp_Drv->Phase--;
		if(Stp_Drv->Phase>=8)
		{
			Stp_Drv->Phase = 7;
		}
	}
	send_mechanics_step(Stp_Drv, full_step_faz[Stp_Drv->Phase]);

	Stp_Drv->Scale_Pos_stp++;
}
/********************************************************************************************************************************************************************************************************/
/********************************************************************************************************************************************************************************************************/
/********************************************************************************************************************************************************************************************************/
void Stepper_Back_Step(struct Stepper_Clock *Stp_Drv) // Ok.
{
	if(Stp_Drv->Dir == CW)
	{
		Stp_Drv->Phase--;
		if(Stp_Drv->Phase>=8)
		{
			Stp_Drv->Phase = 7;
		}
	}
	else
	{
		Stp_Drv->Phase++;
		if(Stp_Drv->Phase>=8)
		{
			Stp_Drv->Phase = 0;
		}
	}
	send_mechanics_step(Stp_Drv, full_step_faz[Stp_Drv->Phase]);

	Stp_Drv->Scale_Pos_stp--;
}
/********************************************************************************************************************************************************************************************************/
/********************************************************************************************************************************************************************************************************/
/********************************************************************************************************************************************************************************************************/
void Stepper_Next_DK(struct Stepper_Clock *Stp_Drv) // Ok.
{
	Stp_Drv->Reel_Pos_dk++;
}
/********************************************************************************************************************************************************************************************************/
/********************************************************************************************************************************************************************************************************/
/********************************************************************************************************************************************************************************************************/
void Stepper_Back_DK(struct Stepper_Clock *Stp_Drv) // Ok.
{
	Stp_Drv->Reel_Pos_dk--;
}
/********************************************************************************************************************************************************************************************************/
/********************************************************************************************************************************************************************************************************/
/********************************************************************************************************************************************************************************************************/
void Stepper_Clock_Process(struct Stepper_Clock *Stp_Drv)
{
	if(Stp_Drv->Step_Time >= Stp_Drv->Acceleration_Time)
	{
		if(Stp_Drv->Acceleration_Time>STEP_TIME)
		{
			Stp_Drv->Acceleration_Time--;
		}
		Stp_Drv->Step_Time = 0;
	}
	else
	{
		Stp_Drv->Step_Time++;
		return;
	}
	
	if(!digitalRead(C, Stp_Drv->Ref_DK_Pin))
	{
		if(Stp_Drv->Act == PASSIVE)
		{
			Stp_Drv->Act           = ACTIVE;
			Stp_Drv->Phase         = 0x01;
			Stp_Drv->Ref_Wait_Time = 0;
			Stp_Drv->Reel_Pos_dk   = 0;
			Stp_Drv->Scale_Pos_dk  = 0;
			Stp_Drv->Reel_Pos_stp  = 0;
			Stp_Drv->Scale_Pos_stp = 0;
			Stp_Drv->State         = CLOCK_STARTUP;
		}
	}
	else
	{
		Stp_Drv->Act   = PASSIVE;
		Stp_Drv->State = CLOCK_PARK;
	}
	
	switch(Stp_Drv->State)
	{
		case CLOCK_STARTUP:
				Stp_Drv->Reel_Pos_stp  = 24576;
				Stp_Drv->Scale_Pos_stp = 0;
				if(!digitalRead(C, Stp_Drv->Ref_12_Pin))	// in the sensor
				{
					Stp_Drv->State = IN_THE_SENSOR;
					Stepper_Off(Stp_Drv);
				}
				else
				{                                           // out of sensor
					Stp_Drv->State = FIND_REF;
					Stepper_Off(Stp_Drv);
				}
			break;
		case IN_THE_SENSOR:
				if(digitalRead(C, Stp_Drv->Ref_12_Pin))
				{
					Stp_Drv->State         = TEN_MIN_GO_BACK;
					Stp_Drv->Reel_Pos_stp  = 24576-600;
					Stp_Drv->Scale_Pos_stp = 24576;
					Stepper_Off(Stp_Drv);
				}
				else
				{
					Stepper_Back_Step(Stp_Drv);
				}
			break;
		case TEN_MIN_GO_BACK:
				if(Stp_Drv->Reel_Pos_stp == Stp_Drv->Scale_Pos_stp)
				{
					Stp_Drv->State         = FIND_REF;
					Stp_Drv->Reel_Pos_stp  = 24576;
					Stp_Drv->Scale_Pos_stp = 0;
					Stepper_Off(Stp_Drv);
				}
				else
				{
					Stepper_Back_Step(Stp_Drv);
				}
			break;
		case FIND_REF:
				if(!digitalRead(C, Stp_Drv->Ref_12_Pin))
				{
					Stp_Drv->Reel_Pos_stp  = 0;
					Stp_Drv->Scale_Pos_stp = 0;
					Stp_Drv->Ref_Wait_Time = (5000 / STEP_TIME);
					Stp_Drv->State         = WAIT_REF;
					Stepper_Off(Stp_Drv);
				}
				else
				{
					Stepper_Next_Step(Stp_Drv);
				}
			break;
		case WAIT_REF:
				if(Stp_Drv->Ref_Wait_Time == 0)
				{
					Stp_Drv->Scale_Pos_dk  = 0;
					Stp_Drv->Reel_Pos_stp  = 0;
					Stp_Drv->Scale_Pos_stp = 0;
					Stp_Drv->State         = NORMAL_MODE;
					Stepper_Off(Stp_Drv);
				}
				else
				{
					Stp_Drv->Ref_Wait_Time--;
				}
			break;
		case NORMAL_MODE:
				if(Stp_Drv->Scale_Pos_dk >= 720)
				{
					Stp_Drv->Scale_Pos_dk  = 0;
					Stp_Drv->Reel_Pos_stp  = 0;
					Stp_Drv->Scale_Pos_stp = 0;
					Stp_Drv->State         = NORMAL_MODE;
				}
			
				if(Stp_Drv->Reel_Pos_dk != Stp_Drv->Scale_Pos_dk)
				{
					Stp_Drv->Reel_Pos_stp += 34;
					if((Stp_Drv->Scale_Pos_dk % 15)==0)
					{
						Stp_Drv->Reel_Pos_stp += 2;
					}
					Stp_Drv->State = STEP_MODE;
				}
				else
				{
					Stepper_Off(Stp_Drv);
				}
			break;
		case STEP_MODE:
				if(Stp_Drv->Reel_Pos_stp != Stp_Drv->Scale_Pos_stp)
				{
					Stepper_Next_Step(Stp_Drv);
				}
				else
				{
					Stp_Drv->Scale_Pos_dk++;
					Stp_Drv->State = NORMAL_MODE;
				}
			break;
	}
}
/********************************************************************************************************************************************************************************************************/
/********************************************************************************************************************************************************************************************************/
/********************************************************************************************************************************************************************************************************/
