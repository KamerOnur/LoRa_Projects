#include "main.h"
#include "digital.h"
#include "Analog_Clock.h"

//PROGRAM FUSE    ***** 0xFFD962 *****
//USART 9600
#define USART_BAUDRATE 4800
#define BAUD_PRESCALE (((1000000 / (USART_BAUDRATE * 16UL))) - 1)

#define  RX_TIME_OVER	50

volatile   uint8_t  clock_front;
volatile   uint8_t  clock_rear;
volatile   uint16_t reel_konum;
volatile   uint16_t kadran_konum;

volatile uint16_t   dl_ms=0;
volatile uint8_t    rx_Buffer[10]={0x00,0x00,0x00,0x00,0x00,0x00,0x00,0x00,0x00,0x00};
volatile uint8_t    rx_byte=0xff;
volatile uint8_t    rx_Count=0;
volatile uint8_t    packet_received=0;
volatile uint16_t   ceksum=0;
volatile uint8_t    rx_time_over=0;
volatile uint8_t    RTC_Update = 0;

uint8_t  prev_minute;

uint8_t dk_tmp=0;


extern struct Stepper_Clock F_Stepper_Clock;
extern struct Stepper_Clock R_Stepper_Clock;

uint16_t k_reel_dk = 0;

/**************************************************************************************************************************************************************************/
/**************************************************************************************************************************************************************************/
/**************************************************************************************************************************************************************************/
void __delay_ms(unsigned int dl)
{
	dl_ms=dl;
	while(dl_ms);
}
/********************************************************************************************************************************************************************************************************/
/********************************************************************************************************************************************************************************************************/
/********************************************************************************************************************************************************************************************************/
ISR(USART_RX_vect)
{
	rx_byte = UDR0;
	
	if(packet_received==0)
	{
		if((rx_Count==0)&&(rx_byte==0x01))
		{
			rx_Buffer[rx_Count]=rx_byte;
			rx_Count++;
			ceksum = rx_byte;
			rx_time_over = RX_TIME_OVER;
		}
		else if((rx_Count==1)&&(rx_byte==0x02))
		{
			rx_Buffer[rx_Count]=rx_byte;
			rx_Count++;
			ceksum+=rx_byte;
			rx_time_over = RX_TIME_OVER;
		}
		else if((rx_Count>=2)&&(rx_Count<=0x04))
		{
			if(rx_Count==2)
			{
				rx_Buffer[rx_Count]=rx_byte;
				rx_Count++;
				ceksum+=rx_byte;
			}
			else if(rx_Count==3)
			{
				rx_Buffer[rx_Count]=rx_byte;
				rx_Count++;
				ceksum+=rx_byte;
			}
			else if(rx_Count==4)
			{
				rx_Buffer[rx_Count]=rx_byte;
				rx_Count++;
				ceksum+=rx_byte;
			}
			rx_time_over = RX_TIME_OVER;
		}
		else if((rx_Count>=5)&&(rx_Count<=0x06))
		{
			if(rx_Count==5)
			{
				rx_Buffer[rx_Count]=rx_byte;
				rx_Count++;
				rx_time_over = RX_TIME_OVER;
			}
			else if(rx_Count==6)
			{
				rx_Buffer[rx_Count]=rx_byte;
				rx_Count++;
				rx_time_over = RX_TIME_OVER;
			}
		}
		else if(rx_Count==7)
		{
			rx_Buffer[rx_Count]=rx_byte;
			rx_Count=0;
			if(rx_Buffer[5]==0x20)
			{
				rx_Buffer[5]=0x00;
			}
			if((((ceksum>>8)&0xff)==rx_Buffer[5])&&((ceksum&0xff)==rx_Buffer[6]))
			{
				packet_received=1;
				rx_Count = 0;
				ceksum   = 0;
			}
			else
			{
				rx_Count = 0;
				ceksum   = 0;
			}
			rx_time_over = RX_TIME_OVER;
		}
		else
		{
			rx_Count = 0;
			ceksum   = 0;
		}
	}
}
/********************************************************************************************************************************************************************************************************/
/********************************************************************************************************************************************************************************************************/
/********************************************************************************************************************************************************************************************************/
ISR(TIMER0_COMPA_vect)
{
	if(dl_ms>0)
	{
		dl_ms--;
	}
	if(rx_time_over>0)
	{
		rx_time_over--;
	}
	else
	{
		rx_Count = 0;
		ceksum   = 0;
	}
	
	Stepper_Clock_Process(&F_Stepper_Clock);
	Stepper_Clock_Process(&R_Stepper_Clock);
}
/********************************************************************************************************************************************************************************************************/
/********************************************************************************************************************************************************************************************************/
/********************************************************************************************************************************************************************************************************/
void Serial_Uart_Init(void)
{
	/* 9600 baud */
	UBRR0L = (uint8_t)(BAUD_PRESCALE & 0xff);
	UBRR0H = (uint8_t)(BAUD_PRESCALE >> 8);
	UCSR0B =
		/* interrupt on receive */
		(1 << RXCIE0) |
		(1 << RXEN0);
	UCSR0C =
		/* no parity bit */
		(0 << UPM01) |
		(0 << UPM00) |
		/* asyncrounous USART */
		(0 << UMSEL01) |
		(0 << UMSEL00) |
		/* one stop bit */
		(0 << USBS0) |
		/* 8-bits of data */
		(1 << UCSZ01) |
		(1 << UCSZ00);
	}
/********************************************************************************************************************************************************************************************************/
/********************************************************************************************************************************************************************************************************/
/********************************************************************************************************************************************************************************************************/
void timer0_init(void)
{
	TCCR0A = (1 << WGM01);
	OCR0A  = 15;
	TIMSK0 = (1 << OCIE0A);
	TCCR0B = (1 << CS01) | (1 << CS00);
}
/********************************************************************************************************************************************************************************************************/
/********************************************************************************************************************************************************************************************************/
/********************************************************************************************************************************************************************************************************/

#define RX_EN   0

int main(void)
{
    packet_received = 1;
    
    cli();
    timer0_init();
    
    pinMode(B,0,OUTPUT);
    digitalWrite(B,0,LOW);
    
    Serial_Uart_Init();
	
	Stepper_Init(&F_Stepper_Clock, 4, F_HEF4094_CLK, 4,  F_HEF4094_DAT, 3, F_REF_12, 3, F_REF_DK);
	Stepper_Init(&R_Stepper_Clock, 4, R_HEF4094_CLK, 4,  R_HEF4094_DAT, 3, R_REF_12, 3, R_REF_DK);
	
    sei();
    
    packet_received = 0;
	
    while(1)
    {
        wdt_reset();
		
        if(packet_received==1)
        {
            k_reel_dk  = rx_Buffer[2];
            k_reel_dk *= 60;
            k_reel_dk += rx_Buffer[3];

            if(k_reel_dk>719)
            {
                k_reel_dk -= 720;
            }
			
			Stepper_Set_Reel_Pos_dk(&F_Stepper_Clock, k_reel_dk);
			Stepper_Set_Reel_Pos_dk(&R_Stepper_Clock, k_reel_dk);

            packet_received=0;
        }
    }
}
/********************************************************************************************************************************************************************************************************/
/********************************************************************************************************************************************************************************************************/
/********************************************************************************************************************************************************************************************************/
